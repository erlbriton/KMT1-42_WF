/**
  ******************************************************************************
  * @file    ID.с
  * @author  IMD, Vasiltsov
  * @version V1.0.0
  * @date    22-01-2026
  * @brief   Файл содержит текст и функцию для формирования ID-строки устройства 
  * 
  ******************************************************************************
  * @Как с этим работать:
  * - в main создать указатель на строку следующеего вида:
  *                 1________  2____  3 _______  4 _____________
  * char* IDtext  ="DExS.M4CPU v0.03 03.06.2013 www.intmash.ru";
  * Это текстовая часть ID-строки, где:
  * 1-название устройства (как правило совпадает с названием платы)
  * 2-версия настоящей прошивки
  * 3-дата последнего изменения прошивки
  * 4-сайт конторы
  *
  * - В тексте программы (например перед инициализацией) вызывается функция 
  * IDinit(u32 SN, char* ID_text), которая формирует ID-строку из серийного 
  * номера SN и текстовой части строки IDtext.
  ******************************************************************************
  */
#include <stdio.h>
#include "stm32f4xx.h"// basic types


char DeviceID[256];//массив для формирования ID-строки

/**
  * @brief  формирование ID-строки в формате xxxxxxxx IDtext, 
  * где xxxxxxxx - серийный номер устросйтва. Если номер не 8-значное число,
  * перед номером будут идти нули, чтобы суммарно было 8 символов. 
  * например 00000365 DExS.M4CPU v0.03 03.06.2013 www.intmash.ru
  * сформированная строка хранится в символьном массиве DeviceID.
  * @param  u32 SN - серийный номер устросйтва, число от 1 до 99999999
  * @retval none.
  */
void IDinit(u32 SN, char* ID_text)
{
  char nulls[8];
  u8 strcnt;
  u8 nullcnt;
  u32 div;
  nullcnt=8;
  div = 1;
  while (div < 10000000) 
  {
    if (SN/div) {nullcnt--; div = div*10;}
    else div = 10000000;
  }
  strcnt = 0;
  while (strcnt < nullcnt)
  {
    nulls[strcnt]='0';
    strcnt++;
  }
  nulls[nullcnt]=0;
  sprintf (DeviceID, "%s%d %s", nulls,SN, ID_text);
}